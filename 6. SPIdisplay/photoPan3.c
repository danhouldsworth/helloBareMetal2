#include <avr/io.h>
#include <avr/pgmspace.h>

// DREAM LIGHTING :
#define WIDTH (128*7)
#define HEIGHT (64*4)
const uint8_t bigPhoto[WIDTH * (HEIGHT / 8)] PROGMEM = {0,0,0,0,0,0,0,0,0,0,0,0,0,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255,127};

void swSPI(uint8_t cData){
    for(uint8_t bit = 0x80; bit; bit >>= 1) {
      PORTD &= ~(1<<PORTD6);    // Clk off
      if(cData & bit)   PORTD |=  (1<<PORTD7);
      else              PORTD &= ~(1<<PORTD7);
      PORTD |= (1<<PORTD6);     // Clk on
    }
}
void bootOLED(uint8_t *ptr){
    for (uint8_t i = 0; i < 10; i++){
        SPDR = *ptr++;
        while(!(SPSR & (1<<SPIF)));
    }
}

int main(void){
    PORTD = DDRD = (1 << DDD3) | (1 << DDD4) |  (1 << DDD2) | (1 << DDD6) | (1 << DDD7); // Reset / OLED DC SS2 / CLK2 / MOSI2
    PORTB = DDRB = (1 << DDB3) | (1 << DDB5) | (1 << DDB2) | (1 << DDB1); // MOSI SCK SS D/C
    SPCR = (1 << SPE) | (1 << MSTR);
    SPSR = (1 << SPI2X);

    PORTB &= ~(1 << PORTB1); // OLED 'Commands'
    PORTB &= ~(1 << PORTB2);
    bootOLED((uint8_t[]){0xAE,0xD5,0x80,0x8D,0x14,0x20,0x00,0x81,0xFF,0xAF});
    PORTB |=  (1 << PORTB2);

    PORTB |=  (1 << PORTB1); // OLED 'Data'
    PORTB &= ~(1 << PORTB2);
    for(uint16_t xOffset =0;;xOffset = 0){
        for(uint8_t bitIndex; xOffset < WIDTH - 128;){
            for (uint16_t y = 0; (y < HEIGHT-128) && (xOffset < WIDTH - 128); y+=2){
                xOffset++;
                bitIndex = y & 0x7;
                for (uint8_t col = y >> 3; col < (y>>3) + 8; col++){
                    for (uint16_t x = xOffset; x < xOffset + 128; x++){
                        SPDR = (pgm_read_byte(&bigPhoto[x + col*WIDTH]) >> bitIndex) + (pgm_read_byte(&bigPhoto[x + (col+1)*WIDTH]) << (8-bitIndex));
                        swSPI((pgm_read_byte(&bigPhoto[x + (col+8)*WIDTH]) >> bitIndex) + (pgm_read_byte(&bigPhoto[x + ((col+8)+1)*WIDTH]) << (8-bitIndex)));
                    }
                }
            }
            for (uint16_t y = HEIGHT-128; (y > 0)&& (xOffset < WIDTH - 128); y-=2){
                xOffset++;
                bitIndex = y & 0x7;
                for (uint8_t col = y >> 3; col < (y>>3) + 8; col++){
                    for (uint16_t x = xOffset; x < xOffset + 128; x++){
                        SPDR = (pgm_read_byte(&bigPhoto[x + col*WIDTH]) >> bitIndex) + (pgm_read_byte(&bigPhoto[x + (col+1)*WIDTH]) << (8-bitIndex));
                        swSPI((pgm_read_byte(&bigPhoto[x + (col+8)*WIDTH]) >> bitIndex) + (pgm_read_byte(&bigPhoto[x + ((col+8)+1)*WIDTH]) << (8-bitIndex)));
                    }
                }
            }
        }
        for(uint8_t bitIndex; xOffset > 0;){
            for (uint16_t y = 0; (y < HEIGHT-128)&& (xOffset > 0); y+=2){
                xOffset--;
                bitIndex = y & 0x7;
                for (uint8_t col = y >> 3; col < (y>>3) + 8; col++){
                    for (uint16_t x = xOffset; x < xOffset + 128; x++){
                        SPDR = (pgm_read_byte(&bigPhoto[x + col*WIDTH]) >> bitIndex) + (pgm_read_byte(&bigPhoto[x + (col+1)*WIDTH]) << (8-bitIndex));
                        swSPI((pgm_read_byte(&bigPhoto[x + (col+8)*WIDTH]) >> bitIndex) + (pgm_read_byte(&bigPhoto[x + ((col+8)+1)*WIDTH]) << (8-bitIndex)));
                    }
                }
            }
            for (uint16_t y = HEIGHT-128; (y > 0)&& (xOffset >0); y-=2){
                xOffset--;
                bitIndex = y & 0x7;
                for (uint8_t col = y >> 3; col < (y>>3) + 8; col++){
                    for (uint16_t x = xOffset; x < xOffset + 128; x++){
                        SPDR = (pgm_read_byte(&bigPhoto[x + col*WIDTH]) >> bitIndex) + (pgm_read_byte(&bigPhoto[x + (col+1)*WIDTH]) << (8-bitIndex));
                        swSPI((pgm_read_byte(&bigPhoto[x + (col+8)*WIDTH]) >> bitIndex) + (pgm_read_byte(&bigPhoto[x + ((col+8)+1)*WIDTH]) << (8-bitIndex)));
                    }
                }
            }
        }
    }

}
