;               328p          1284p
; Clock         16MHz           16MHz
; OLED D/C      B1              B1

; SS            B2              B4
; MOSI          B3              B5
; MISO          B4              B6
; SCK           B5              B7

; BreadBoard OLED
; ISP breakout : RST / MOSI / SCK
; Power Rails
; CS=SS | D/C = PB1


.include "../Reference/Libs/defSheets/m1284Pdef.inc"

.def    temp    = r16
.def    xPos    = r17
.def    colPos  = r18
.def    cData   = r19

.cseg
.org 0x0000
jmp    setup

setup:
        ldi temp, (1 << DDB5) | (1 << DDB7) | (1 << DDB4) | (1 << DDB1) ; MOSI SCK SS D/C
        out DDRB, temp
        out PORTB, temp

        ldi temp, (1 << SPE)
        ori temp, (1 << MSTR)
        out SPCR, temp

        ldi temp, (1 << SPI2X)
        out SPSR, temp

        rcall bootOLED
        rcall dumpBitmap

loopForever:
        rjmp    loopForever

hwSPI:
        out SPDR, cData
waitSPIF:
        in temp, SPSR
        sbrs temp, SPIF
        brne waitSPIF
        ret

dumpBitmap:
        ldi ZH, high(OLEDphotoData << 1)
        ldi ZL, low(OLEDphotoData << 1)
        sbi PORTB, PORTB1               ; OLED 'Data'
        rcall squirtToOLED
        ret

bootOLED:
        ldi ZH, high(OLEDBootSequence << 1)
        ldi ZL, low(OLEDBootSequence << 1)
        cbi PORTB, PORTB1               ; OLED 'Commands'
        rcall squirtToOLED
        ret

squirtToOLED:
        lpm r25, Z+                     ; HB data length
        lpm r24, Z+                     ; LB data length
        cbi PORTB, PORTB4               ; CS low

twobyteloop:
        lpm cData, Z+
        rcall hwSPI
        sbiw    r24,1                    ; SuBtract Immediate from Word (ie 2 byte reg)
        brne    twobyteloop
        sbi PORTB, PORTB4               ; CS high
        ret

OLEDBootSequence:
.db     0, 10
.db     0xAE,0xD5,0x80,0x8D,0x14,0x20,0x00,0x81,0xFF,0xAF
OLEDphotoData:
.db     4, 0
.db     0xFF, 0xFF, 0xBF, 0xDF, 0xDF, 0xDF, 0xDF, 0xDF, 0xBF, 0x3F, 0xFF, 0xFF, 0xFF, 0xFF, 0xFF, 0xFF
.db     0xFD, 0xFD, 0x01, 0x7F, 0xBF, 0xDF, 0xDF, 0xDF, 0xDF, 0xBF, 0x7F, 0xFF, 0xFF, 0xFF, 0xFF, 0xFF
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.db     0xFF, 0xBF, 0xBF, 0x80, 0xBF, 0xBF, 0xFF, 0xFF, 0xBF, 0xBF, 0x80, 0xBF, 0xBF, 0xFF, 0xFF, 0xFF
