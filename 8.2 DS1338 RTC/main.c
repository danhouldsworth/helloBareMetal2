/*
            328p        1284p
    SDA     PC4         PC1
    SCL     PC5         PC0
    Board   SL018       DC1338
    Trigger PC3         -
    SQW     -           PD7
*/

#include <avr/interrupt.h>
#include <avr/pgmspace.h>
#define SLVADD      0xd0

//============================================
//  global variable define
//============================================
unsigned long int   g_iTimer    = 0;
uint8_t             g_bOverTime = 0;
uint8_t             RxBuffer[8];
//============================================

//============================================
// OLED display in PRGSPACE
//============================================
const char OLEDbootSequence[]   PROGMEM = {0xAe,0xD5,0x80,0x8D,0x14,0x20,0x00,0x81,0xFF,0xAF};
const char asciiBitmaps[760]    PROGMEM = {0xFF, 0xFF, 0xFF, 0xFF, 0xFF, 0xFF, 0xFF, 0xFF, 0xFF, 0xFF, 0x7F, 0x41, 0xFF,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 0xFF, 0xFF};
//============================================
const char commandTest[]  = {7,0,0,0,0,0,0,0};
//============================================
// SPI / OLED functions
//============================================
void writeSPIbyte(char value){SPDR = value; while(!(SPSR & (1<<SPIF)));}
void writePROGMEMtoSPI(const char *ptrToPROGMEM, uint16_t count, char invert){
    PORTB &= ~(1 << PORTB4);
    if (invert) while(count--) writeSPIbyte(~pgm_read_byte(ptrToPROGMEM++));
    else        while(count--) writeSPIbyte( pgm_read_byte(ptrToPROGMEM++));
    PORTB |=  (1 << PORTB4);
}
void writeChar(char charCode){
    uint16_t bitmapIndex = (charCode - 32) * 8;
    writePROGMEMtoSPI(&asciiBitmaps[bitmapIndex], 8, 1); // Invert the text for aesthetics
}
void writeString(const char *ptrToProgmem){
    char nextByte;
    while ((nextByte = pgm_read_byte(ptrToProgmem++))) writeChar(nextByte);
}
void printfOLED(const char *ptrToSRAM){
    char nextByte;
    while ((nextByte = *ptrToSRAM++)) writeChar(nextByte);
}
void printfOLEDasBinary(const char singleByte){
    writeChar('0' + ((singleByte & (1 << 7)) >> 7) );
    writeChar('0' + ((singleByte & (1 << 6)) >> 6) );
    writeChar('0' + ((singleByte & (1 << 5)) >> 5) );
    writeChar('0' + ((singleByte & (1 << 4)) >> 4) );
    writeChar('0' + ((singleByte & (1 << 3)) >> 3) );
    writeChar('0' + ((singleByte & (1 << 2)) >> 2) );
    writeChar('0' + ((singleByte & (1 << 1)) >> 1) );
    writeChar('0' + ((singleByte & (1 << 0)) >> 0) );
}
char nibbleToASCIIhex(char nibble){
    return (nibble <= 9) ? ('0' + nibble) : ('A' + nibble - 10);
}
void printfOLEDasHEX(const char singleByte){
    writeChar(nibbleToASCIIhex((singleByte & (0xf0)) >> 4));
    writeChar(nibbleToASCIIhex((singleByte & (0x0f)) >> 0));
}
//============================================

//============================================
// Timer / counter functions
//============================================
void wait(unsigned long int ms) {
    g_iTimer        = ms;
    g_bOverTime     = 0;
    while(g_bOverTime == 0){}
    g_iTimer = 0;
}
ISR(TIMER0_OVF_vect) {
    TCNT0 = 0;
    if (g_iTimer != 0) {
        g_iTimer--;
        if (g_iTimer == 0) {
            g_bOverTime = 1;
        }
    }
}
//============================================

//============================================
// Pin Chnage Interupt
//============================================
ISR(PCINT3_vect){
    printfOLED("PCINT3_vect :   ");
}
//============================================

//============================================
// Decimal to BCD macros
//============================================
char decToBcd(char val){return ( (val/10*16) + (val%10) );}
char bcdToDec(char val){return ( (val/16*10) + (val%16) );}
//============================================

void Init_Hardware() {
        cli();
        //============================================
        // Setup OLED / SPI
        //============================================
        PORTB = DDRB = (1 << DDB5) | (1 << DDB7) | (1 << DDB4) | (1 << DDB1); // MOSI SCK SS D/C
        SPCR = (1 << SPE) | (1 << MSTR);
        SPSR = (1 << SPI2X);

        PORTB &= ~(1 << PORTB1); // OLED 'Commands'
        writePROGMEMtoSPI(&OLEDbootSequence[0], 10, 0);
        PORTB |= (1 << PORTB1); // OLED 'Commands'
        printfOLED("OLED Test 1     ");printfOLED("OLED Test 2     ");printfOLED("OLED Test 3     ");printfOLED("OLED Test 4     ");printfOLED("OLED Test 5     ");printfOLED("OLED Test 6     ");printfOLED("OLED Test 7     ");printfOLED("OLED Test 8     ");
        //============================================

        //============================================
        // Setup PCINT for SQW
        //============================================
        PCICR  = (1 << PCIE3);                                      // Enables PC interrupt #0
        PCMSK3 = (1 << PCINT31);                                    // Enable PCINT1 to fire PC INT #0
        DDRD    = PORTD = 0;                                        // PD7 INPUT (SQW)
        //============================================

        //============================================
        // Setup I2C at 400kHz
        //============================================
        DDRC    = 0;                                                // Clock | SDA can be in / out
        // PORTC  |= (1 << PORTC5) | (1 << PORTC4);                    // ATmega328p Clock / SDA must start High
        PORTC  |= (1 << PORTC0) | (1 << PORTC1);                    // ATmega1284p Clock / SDA must start High
        TWSR    = 0;   // Set both prescaler bits for 0 === /1
        TWBR    = 2;   // BitRate = 400kHz @ 8MHz /1 prescaler
        TWBR    = 12;   // BitRate = 400kHz @ 16MHz /1 prescaler
        //============================================

        //============================================
        // Setup TIMER0 as ms clock
        //============================================
        // COM0A    = 0 (off)
        // COM0B    = 0 (off)
        // WGM      = 0 (Normal)
        // CS       = 3 (Prescaler = /64)
        TCCR0A  = (0 << COM0A1) | (0 << COM0A0) | (0 << COM0B1) | (0 << COM0B0) | (0 << WGM01) | (0 << WGM00);
        TCCR0B  = (0 << WGM02)  | (0 << CS02)   | (1 << CS01)   | (1 << CS00);
        TIMSK0  = (0 << OCIE0B) | (0 << OCIE0A) | (1 << TOIE0);
        // TCNT0    = 130;      // Set the counter to leave 125 clks which takes 1ms @ 8MHz
        TCNT0    = 0;      // Set the counter to leave 125 clks which takes 1ms @ 16MHz
        //============================================
        sei();
}
void ReadBuf_I2C() {
    // printfOLED("ReadBuf_I2C()   ");
    TWCR = (1 << TWINT) | (1 << TWEN) | (1 << TWSTA);   while((TWCR & (1 << TWINT)) == 0){} // I2C Start
    // printfOLED("I2C Start - Done");
    TWDR = SLVADD | 0;  // Address & Write
    TWCR = (1 << TWINT) | (1 << TWEN);                  while((TWCR & (1 << TWINT)) == 0){} // I2C TX
    // printfOLED("I2C Address | W ");
    TWDR = 0;  // Low byte address
    TWCR = (1 << TWINT) | (1 << TWEN);                  while((TWCR & (1 << TWINT)) == 0){} // I2C TX
    // printfOLED("I2C ZERO BYTE.  ");
    TWCR = (1 << TWINT) | (1 << TWEN) | (1 << TWSTO);                                       // I2C STOP
    // printfOLED("I2C STOP CONITIN");
    wait(50);
    TWCR = (1 << TWINT) | (1 << TWEN) | (1 << TWSTA);   while((TWCR & (1 << TWINT)) == 0){} // I2C Start
    // printfOLED("I2C Start - Done");
    TWDR = SLVADD | 1;  // Address & Read
    TWCR = (1 << TWINT) | (1 << TWEN);                  while((TWCR & (1 << TWINT)) == 0){} // I2C TX
    // printfOLED("I2C Address | R ");
    wait(50);
    TWCR = (1 << TWINT) | (1 << TWEN) | (1 << TWEA);    while((TWCR & (1 << TWINT)) == 0){}; RxBuffer[0] = TWDR;
    TWCR = (1 << TWINT) | (1 << TWEN) | (1 << TWEA);    while((TWCR & (1 << TWINT)) == 0){}; RxBuffer[1] = TWDR;
    TWCR = (1 << TWINT) | (1 << TWEN) | (1 << TWEA);    while((TWCR & (1 << TWINT)) == 0){}; RxBuffer[2] = TWDR;
    TWCR = (1 << TWINT) | (1 << TWEN) | (1 << TWEA);    while((TWCR & (1 << TWINT)) == 0){}; RxBuffer[3] = TWDR;
    TWCR = (1 << TWINT) | (1 << TWEN) | (1 << TWEA);    while((TWCR & (1 << TWINT)) == 0){}; RxBuffer[4] = TWDR;
    TWCR = (1 << TWINT) | (1 << TWEN) | (1 << TWEA);    while((TWCR & (1 << TWINT)) == 0){}; RxBuffer[5] = TWDR;
    TWCR = (1 << TWINT) | (1 << TWEN) | (1 << TWEA);    while((TWCR & (1 << TWINT)) == 0){}; RxBuffer[6] = TWDR;
    TWCR = (1 << TWINT) | (1 << TWEN);                  while((TWCR & (1 << TWINT)) == 0){}; RxBuffer[7] = TWDR;

    TWCR = (1 << TWINT) | (1 << TWEN) | (1 << TWSTO);                                       // I2C STOP
    // printfOLED("I2C STOP CONITIN");
    wait(50); // <20ms and SL018 doesn't response to subsequent read / writes
}

int main() {
    Init_Hardware();
    while(1) {
        ReadBuf_I2C();
        printfOLED("                ");
        printfOLED("Time: ");printfOLEDasHEX(RxBuffer[2]-1);printfOLED(":");printfOLEDasHEX(RxBuffer[1]);printfOLED(":");printfOLEDasHEX(RxBuffer[0]);printfOLED("s ");
        printfOLED("                ");
        printfOLED("Date: ");printfOLEDasHEX(RxBuffer[4]);printfOLED("/");printfOLEDasHEX(RxBuffer[5]);printfOLED("/20");printfOLEDasHEX(RxBuffer[6]);
        printfOLED("                ");
        switch(RxBuffer[3]){
            case 0 : printfOLED("Day : Monday    ");break;
            case 1 : printfOLED("Day : Tuesday   ");break;
            case 2 : printfOLED("Day : Wedneday  ");break;
            case 3 : printfOLED("Day : Thursday  ");break;
            case 4 : printfOLED("Day : Friday    ");break;
            case 5 : printfOLED("Day : Saturday  ");break;
            case 6 : printfOLED("Day : Sunday    ");break;
            case 7 : printfOLED("Day : Day : 7   ");break;
        }
        printfOLED("                ");
        printfOLED("Control "); printfOLEDasBinary(RxBuffer[7]);
        wait(1000); // Ideally should be interupt driven from SQW PINC
    }
}